## components/MerusAudio_i2s/Kconfig.projbuild
```kconfig
menu "Merus MA120x0 i2s Configuration"

    
    config CONFIG_I2S_BCL_PIN
        int "I2S bit clock pin"
        default 25
        help
            -.

    config CONFIG_I2S_WS_PIN
        int "I2S word select pin"
        default 26
        help
            -.

    config CONFIG_I2S_SDA_PIN
        int "I2S serial data pin"
        default 27
        help
            -.

endmenu
```

## main/Kconfig.projbuild
```kconfig
menu "A2DP Example Configuration"

    choice EXAMPLE_A2DP_SINK_OUTPUT
        prompt "A2DP Sink Output"
        default EXAMPLE_A2DP_SINK_OUTPUT_EXTERNAL_I2S
        help
            Select to use Internal DAC or external I2S driver

        config EXAMPLE_A2DP_SINK_OUTPUT_INTERNAL_DAC
            bool "Internal DAC"
            help
                Select this to use Internal DAC sink output

        config EXAMPLE_A2DP_SINK_OUTPUT_EXTERNAL_I2S
            bool "External I2S Codec"
            help
                Select this to use External I2S sink output

    endchoice

endmenu
```
